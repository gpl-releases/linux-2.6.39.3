## arch/arm/mach-avalanche/Kconfig
```kconfig
menu "Avalanche SoC Common Options"

#
# Configuration options common to all avalanche series processors come here.
#
config ARCH_SUPPORTS_BIG_ENDIAN
        bool
        default y
        help
          Some machines can be configured for either little or big endian
          byte order. These modes require different kernels. Say Y if your
          machine is little endian, N if it's a big endian machine.

config ARM_AVALANCHE_SOC
        bool "Support for ARM based Avalanche Series TI BroadBand Processor(s)"
    select DMA_NONCOHERENT
    select SWAP_IO_SPACE
    select NONCOHERENT_IO
        help
      Select this option if you intend to run on any of the Avalanche Series
      of the BroadBand Processor(s) by TI.
      Selecting Y will further probe the specific SoC type you want to run on.
      If in doubt say Y.

config CPU_FREQUENCY_AVALANCHE
	depends on ARM_AVALANCHE_SOC
	int "Avalanche SoC CPU frequency (MHz)"
	default 400
	help
      Choose the default value here. The correct value will be read from
      the bootloader environment variables.

config ARM_AVALANCHE_TOP_MEM_RESERVED
	depends on ARM_AVALANCHE_SOC
	hex "Amount of memory to be reserved on the top of RAM" 
	default 0x0
    range 0x0 0x200000
	help
      Select the amount of RAM you would like to be kept of the control of linux.
      This memory is reserved from the top of RAM


config AVALANCHE_GENERIC_GPIO
	depends on ARM_AVALANCHE_SOC
	bool "Avalanche GPIO support"
	default y
	help
      Choose Y here if you wish to use the Avalanche GPIO facility.
      If unsure, choose Y.

config ARM_AVALANCHE_TIMER16 
	depends on ARM_AVALANCHE_SOC
	bool "Avalanche Timer 16 support"
	default y
	help
      Choose Y here if you wish to use the Avalanche Timer 16
      facility. If unsure, choose Y.

choice
	prompt "Kernel compression method"
	depends on ARM_AVALANCHE_SOC
	help
      Select the compression algoritm for compressing your kernel.

config KERNEL_COMPRESS_7ZIP
	bool 'Use 7ZIP to compress the kernel image'
    help
      Compress the kernel using 7ZIP. Compressed kernel can be
      generated by make ram_zimage.

config KERNEL_COMPRESS_GZIP
	bool 'Use GZIP to compress the kernel image'
    help
      Choose Y to compress the kernel using GZIP. Compressed kernel can be
      generated by make ram_zimage.

endchoice

config AVALANCHE_SERIAL_AUTOFLOW 
	depends on ARM_AVALANCHE_SOC
	bool "Avalanche Serial autoflow"
	default y
	help
      Choose Y here if you want to enable Auto flow control on Avalanche
      serial device. If unsure choose Y.

config ARM_AVALANCHE_INTC 
	def_bool ARM_AVALANCHE_SOC

config AVALANCHE_INTC_PACING
	depends on ARM_AVALANCHE_INTC
	bool "Avalanche Interrupt Pacing Enable"
	default y
	help
      Choose Y here if you wish to use the interrupt pacing feature of the
      Avalanche interrupt controller hardware. If unsure, choose Y.

config AVALANCHE_INTC_LEGACY_SUPPORT
	depends on ARM_AVALANCHE_INTC	
    bool "Avalanche interrupt type and level setting"
	default y
	help
      Choose Y here if you wish to have the ability to set the interrupt
	  type (level or edge triggered) and Level active low or high in avalanche 
	  interrupt controller hardware. If unsure, choose Y.

config AVALANCHE_INTC_ALL_FAST_INTERRUPTS
	depends on AVALANCHE_INTC_DISPATCH_ISR_USING_DO_IRQ = 'n'
	bool "Assume all Avalanche interrupts as 'Fast'"
	default n
	help
      This option ignores the SA_INTERRUPT flag provided with request_irq 
      and locks out all the interrupts on the system whenever any 
      interrupt is being serviced. This will decrease the time taken 
      for ISR to be invoked. Not recommended if any of the interrupts in your
      system is expected to take a long time to execute.
      If unsure, say N. 

#
# Get to know which specific SoC type the user wants to compile for.
#
choice
	prompt "Intel BroadBand SOC Type (Avalanche Series)"
	depends on ARM_AVALANCHE_SOC
	help
      Select the Intel BoardBand SoC Type that you want the kernel port for. If
      unsure, contact your software vendor.

config MACH_PUMA5
        bool "Intel Puma5 SOC"

config MACH_PUMA6
        bool "Puma6 SOC"

endchoice



if MACH_PUMA5 = 'y'
    source "arch/arm/mach-avalanche/ti_puma5/Kconfig"
endif

if MACH_PUMA6 = 'y'
    source "arch/arm/mach-avalanche/puma6/Kconfig"
endif

endmenu

#
# Select some configuration options automatically based on user selections.
#

config  DMA_NONCOHERENT
	bool

config SWAP_IO_SPACE
	bool

config NONCOHERENT_IO
	bool
```
